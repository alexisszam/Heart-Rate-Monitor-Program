/*
  Author: Ricardo Alexis Zamora Acosta
  Contact Email: zamoraa.alexiss@gmail.com
  Created at: University of Groningen (RUG)
  Date: June 2024
  Description: This code is designed to display an interface for a Heart Rate Monitor.
  Additional Info: Tested with CH340, using Arduino IDE version 2.3.2
*/

#include <Adafruit_GFX.h>       // Library needed for OLED display
#include <Adafruit_SSD1306.h>   // Library needed for OLED display
#include <Wire.h>               // Library needed for I2C communication

static const unsigned char PROGMEM Universities[] ={   // Bitmap array for displaying the logos of RUG nad UNAM
0x00, 0x00, 0x00, 0x1e, 0x00, 0x00, 0x00, 0x00, 0x00, 0x00, 0x0f, 0xff, 0xf0, 0x00, 0x00, 0x00, 
0x00, 0x00, 0x00, 0x7f, 0x00, 0x00, 0x00, 0x00, 0x01, 0xf0, 0x16, 0x82, 0x50, 0x0f, 0x00, 0x00, 
0x00, 0x00, 0x01, 0xff, 0x40, 0x00, 0x00, 0x00, 0xe0, 0xa9, 0x6f, 0xe3, 0x5f, 0xd2, 0x1c, 0x00, 
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0x00, 0x00, 0x00, 0x00, 0x00, 0x00, 0x00, 0x00, 0x00, 0x00, 0x00, 0x02, 0xc0, 0x00, 0x00, 0x00
};

static const unsigned char PROGMEM heart[] ={  // Bitmap array for displaying a heart 
0x10, 0x10, 0x38, 0x38, 0x7c, 0x7c, 0xfe, 0xfe, 0xff, 0xfe, 0xff, 0xfe, 0xee, 0xee, 0xd5, 0x56, 
0x3b, 0xb8, 0x3f, 0xf8, 0x1f, 0xf0, 0x0f, 0xe0, 0x07, 0xc0, 0x03, 0x80, 0x01, 0x00
};

static const unsigned char PROGMEM beat[] ={  // Bitmap array for displaying a heart of minor size to simulate an animation of a heart beat
  0x10, 0x04, 0x00, 0x38, 0x0e, 0x00, 0x7c, 0x1f, 0x00, 0xfe, 0x3f, 0x80, 0xff, 0x7f, 0x80, 0xff, 
0xff, 0x80, 0xff, 0xff, 0x80, 0xdf, 0x7d, 0x80, 0xae, 0xba, 0x80, 0x75, 0xd7, 0x00, 0x3b, 0xee, 
0x00, 0x1f, 0xfc, 0x00, 0x0f, 0xf8, 0x00, 0x07, 0xf0, 0x00, 0x03, 0xe0, 0x00, 0x01, 0xc0, 0x00, 
0x00, 0x80, 0x00
};

const int sensorPin = A0;             // Sensor pin for analog input
const int threshold = 300;            // Threshold value for peak detection
const int t_entre_picos = 200;        // Minimum time between peaks (in milliseconds)
const int OLED_RESET = LED_BUILTIN;   // Reset pin for the OLED display


int sensorValue;                      // Variable to store the sensor value
unsigned long previousMillis = 0;     // Variable to store the previous millisecond count
const long interval = 15000;          // Interval for the BPM calculation (in milliseconds)
unsigned long startTime;              // Variable to store the start time
int peakCount = 0;                    // Counter for the number of peaks detected

#define SCREEN_WIDTH 128   // OLED display dimensions
#define SCREEN_HEIGHT 64
Adafruit_SSD1306 display(SCREEN_WIDTH, SCREEN_HEIGHT, &Wire, OLED_RESET); // Create an instance of the SSD1306 display

void read_temp() {    // Function to read the sensor value and update the display
    unsigned long currentMillis = millis();   // Get the current millisecond count
    sensorValue = analogRead(sensorPin);      // Read the sensor value from the analog pin

    int yPos = map(sensorValue, 0, 1023, SCREEN_HEIGHT / 2, 0);               // Map the sensor value to the y-position on the display
    int xPos = map(currentMillis - startTime, 0, interval, 0, SCREEN_WIDTH);  // Calculate the x-position based on the elapsed time

    static int lastYPos = yPos;     // Static variables to store the last positions and state
    static int lastXPos = xPos;
    static int lastPeakCount = 0;
    static bool heartState = true;

    display.drawLine(lastXPos, lastYPos, xPos, yPos, SSD1306_WHITE); // Draw a line from the last position to the current position that would be making the visualization inreal time

    lastYPos = yPos;   // Update the last positions
    lastXPos = xPos;

    // Function for Peak detection
    if (sensorValue > threshold && currentMillis - previousMillis > t_entre_picos) {
        peakCount++;  // Increment the peak count
        previousMillis = currentMillis;  // Update the previous millisecond count

        // Clear the rectangle where the heart/beat icon will be drawn
        display.fillRect(57, 48, 18, 18, SSD1306_BLACK);

        // Toggle the heart state if the peak count has changed
        if (peakCount != lastPeakCount) {
            heartState = !heartState; 
            lastPeakCount = peakCount;
        }

        // Draw the heart or beat icon based on the heart state for simulating of a heart beat
        if (heartState) {
            display.drawBitmap(57, 48, beat, 17, 17, 1);
        } else {
            display.drawBitmap(57, 48, heart, 15, 15, 1);
        }
    }

    if (currentMillis - startTime >= interval) {  // If the interval has passed, calculate and display the BPM
        int bpm = int(peakCount * 2);

        lastXPos = xPos = 0;   // Reset the x-position and clear the display
        display.clearDisplay();
        
        // Display BPM or "Measuring" text based on the BPM range
        if (bpm < 40 || bpm > 120) {
            display.setTextSize(1);
            display.setCursor(0, 52);
            display.println("Measuring");
            display.drawBitmap(57, 48, heart, 16, 16, 1); 
            display.setTextSize(2);
            display.setCursor(76, 50);
            display.print("BPM");
        } else {
            display.setTextSize(2);
            display.setCursor(16, 50);
            display.print(bpm);
            display.drawBitmap(56, 48, heart, 16, 16, 1); 
            display.setTextSize(2);
            display.setCursor(76, 50);
            display.print("BPM");
        }
        
        display.display();  
        
        peakCount = 0;  // Reset the peak count
        startTime = currentMillis;  // Reset the start time
        delay(100); 
    } else {
        display.display();  
    }
}

// Setup function to initialize the display and sensor
void setup() {
    display.begin(SSD1306_SWITCHCAPVCC, 0x3C);  // Initialize the display with I2C address
    display.clearDisplay();  // Clear the display
    display.drawBitmap(0, 0, Universities, 128, 64, 1);  // Show "Universities" image
    display.display();  // Update the display
    delay(3000);  // Wait for 3 seconds
    display.clearDisplay();  // Clear the display
    Serial.println("Starting...");

    display.clearDisplay();   // Display text
    display.setTextSize(1);
    display.setTextColor(SSD1306_WHITE);
    display.setCursor(0, 52);
    display.println("Measuring");
    display.setTextSize(2);
    display.setCursor(76, 50);
    display.print("BPM");
    display.display();
    delay(100); 

    pinMode(sensorPin, INPUT);  // Set the sensor pin as input
    startTime = millis();
    Serial.println("Setup complete");
}

// Main loop function to continuously read sensor data and update the display
void loop() {
    read_temp();  // Call the read_temp function
}